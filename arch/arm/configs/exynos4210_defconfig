## drivers/media/video/samsung/Kconfig
```kconfig
config VIDEO_SAMSUNG
	bool "Samsung Multimedia Devices"
	depends on VIDEO_CAPTURE_DRIVERS && VIDEO_V4L2
	select VIDEO_FIXED_MINOR_RANGES
	default n
	help
	  This is a representative video4linux configuration for Samsung multimedia devices.

config VIDEO_SAMSUNG_V4L2
	bool "V4L2 API for digital camera to be contributed by samsung"
	depends on VIDEO_DEV && VIDEO_SAMSUNG
	default n
	help
	  This feature is for new V4L2 APIs all about digital camera

if CPU_EXYNOS4210
source "drivers/media/video/samsung/fimc/Kconfig"
source "drivers/media/video/samsung/fimg2d/Kconfig"
source "drivers/media/video/samsung/jpeg/Kconfig"
endif


if VIDEO_SAMSUNG
comment "Reserved memory configurations"
config VIDEO_SAMSUNG_MEMSIZE_FIMC0
	int "Memory size in kbytes for FIMC0"
	depends on VIDEO_FIMC
	default "5120"

config VIDEO_SAMSUNG_MEMSIZE_FIMC1
	int "Memory size in kbytes for FIMC1"
	depends on VIDEO_FIMC
	default "5120"

config VIDEO_SAMSUNG_MEMSIZE_FIMC2
	int "Memory size in kbytes for FIMC2"
	depends on VIDEO_FIMC
	default "5120"

config VIDEO_SAMSUNG_MEMSIZE_FIMC3
	int "Memory size in kbytes for FIMC3"
	depends on VIDEO_FIMC && CPU_EXYNOS4210
	default "5120"
config VIDEO_SAMSUNG_MEMSIZE_JPEG
	int "Memory size in kbytes for JPEG"
	depends on VIDEO_JPEG
	default "24576"
endif
```

## drivers/net/wireless/ath/ath6kl/Kconfig
```kconfig
config ATH6KL
	tristate "Atheros ath6kl support"
	depends on MMC
	depends on CFG80211
	---help---
	  This module adds support for wireless adapters based on
	  Atheros AR6003 chipset running over SDIO. If you choose to
	  build it as a module, it will be called ath6kl. Pls note
	  that AR6002 and AR6001 are not supported by this driver.

config ATH6KL_DEBUG
	bool "Atheros ath6kl debugging"
	depends on ATH6KL
	---help---
	  Enables debug support

config ATH6KL_PLATFORM_DATA
        bool "Atheros ath6kl Platform data support"
        depends on ATH6KL
        ---help---
          Enables ath6kl platform data
```

## drivers/staging/samsung_modem/Kconfig
```kconfig
config USB_CDC_SVNET
	tristate "CDC Svnet support"
	select PHONET
	help
	  Choose this option to support the Samsung virtual network interface
	  using Phonet.
```

## drivers/video/samsung/Kconfig
```kconfig
#
# S3C Video configuration
#

config FB_S3C
	tristate "S3C Framebuffer support"
	select FB_CFB_FILLRECT
	select FB_CFB_COPYAREA
	select FB_CFB_IMAGEBLIT
	depends on FB && (ARCH_S5PV210 || ARCH_EXYNOS4)
	default n
	help
	  This enables support for Samsung Display Controller (FIMD)

config FB_S3C_SPLASH_SCREEN
	bool "SPLASH_SCREEN on LCD"
	depends on FB_S3C
	default y

config FB_S3C_LCD_INIT
	bool "LCD init in kernel"
	depends on FB_S3C
	default y

config FB_S3C_DEBUG
	bool "S3C Framebuffer debug messages"
	depends on FB_S3C

config FB_S3C_TRACE_UNDERRUN
	bool "S3C Framebuffer FIFO underrun trace"
	depends on FB_S3C

config FB_S3C_DUAL_LCD
	bool "Dual LCD mode"
	depends on FB_S3C && ARCH_EXYNOS4
	default n

config FB_S3C_DEFAULT_WINDOW
	int "Default Window (0-4)"
	depends on FB_S3C
	default "2"
	help
	  This indicates the default window number, and which is used as console framebuffer

config FB_S3C_NR_BUFFERS
	int "Number of frame buffers (1-3)"
	depends on FB_S3C
	default "1"
	help
	  This indicates the number of buffers for pan display,
	  1 means no pan display and
	  2 means the double size of video buffer will be allocated for default window

config FB_S3C_VIRTUAL
	bool "Virtual Screen"
	depends on FB_S3C
	default n
	help
	  This uses 1920 x 1080 virtual screen.

config FB_S3C_X_VRES
	int "xres_virtual"
	depends on FB_S3C && FB_S3C_VIRTUAL
	default "1920"
	help
	  This indicates var.xres_virtual which has to be bigger than var.xres.

config FB_S3C_Y_VRES
	int "yres_virtual"
	depends on FB_S3C && FB_S3C_VIRTUAL
	default "1080"
	help
	  This indicates var.yres_virtual which has to be bigger than var.yres.

config VIDEO_SAMSUNG_MEMSIZE_FIMD0
	int "Memory size in kbytes for FIMD0"
	depends on FB_S3C
	default "5120"

config VIDEO_SAMSUNG_MEMSIZE_FIMD1
	int "Memory size in kbytes for FIMD1"
	depends on FB_S3C && FB_S3C_DUAL_LCD
	default "24576"

config SUPPORT_UMP
	bool "Support UMP (Unified Memory Provider) for FIMD "
	depends on FB_S3C && VIDEO_UMP
	default y

choice
depends on FB_S3C
prompt "Select LCD Type"
default FB_S3C_AMS369FG06
config FB_S3C_LTE480WV
	bool "LTE480WV"
	depends on MACH_SMDKV310 || MACH_SMDKC210 || MACH_SMDKV210 || MACH_SMDKC110 || MACH_ORIGEN
	help
	  This enables support for Samsung LTE480WV 4.8" WVGA LCD panel

config FB_S3C_LD9040
	bool "LD9040"
	depends on MACH_SMDKV310 || MACH_SMDKC210 || MACH_SMDKV210 || MACH_SMDK4210
	help
	  This enables support for Samsung LD9040 AMOLED Panel

config FB_S3C_WA101S
	bool "WA101S"
	depends on MACH_SMDKV310 || MACH_SMDKC210
	help
	  This enables support for 10.1" 1366*768 LCD panel

config FB_S3C_AMS369FG06
	bool "AMS369FG06"
	depends on MACH_SMDKV310 || MACH_SMDKC210
	select SPI
	select SPI_S3C64XX
	help
	  This enables support for Samsung AMS369FG06 3.7" WVGA AMOLED panel
endchoice

config FB_S3C_V2
	tristate "S3C Framebuffer version 2 support"
	select FB_CFB_FILLRECT
	select FB_CFB_COPYAREA
	select FB_CFB_IMAGEBLIT
	select FRAMEBUFFER_CONSOLE_DETECT_PRIMARY
	depends on FB && (FB_S3C != y) && (FB_S3C != m) && (ARCH_S3C64XX || ARCH_S5P64XX || ARCH_S5PC1XX || ARCH_S5P6450)
	default n
	---help---
	  This enables support for Samsung Display Controller (FIMD)

config FB_S3C_V2_DEBUG
        bool "S3C Framebuffer version 2 debug messages"
        depends on FB_S3C_V2

config FB_S3C_V2_TRACE_UNDERRUN
        bool "S3C Framebuffer version 2 FIFO underrun trace"
        depends on FB_S3C_V2

config FB_S3C_V2_DEFAULT_WINDOW
	int "Default Window (0-4)"
	depends on FB_S3C_V2
	default "1"
	---help---
	  This indicates the default window number, and which is used as console framebuffer

config FB_S3C_V2_YPANSTEP
	int "Vertical Panning Step (0-2)"
	depends on FB_S3C_V2
	default "1"
	---help---
	  This indicates the number of vertical steps for pan display, 0 means no pan display and
	  1 means the double size of video buffer will be allocated for default window
```
